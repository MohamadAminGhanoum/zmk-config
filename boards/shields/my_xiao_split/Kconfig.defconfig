## boards/shields/my_xiao_split/Kconfig.defconfig
```kconfig
if SHIELD_MY_XIAO_SPLIT_LEFT

config ZMK_KEYBOARD_NAME
    default "AbohishamK"

config ZMK_SPLIT_ROLE_CENTRAL
    default y

endif # SHIELD_MY_XIAO_SPLIT_LEFT

if SHIELD_MY_XIAO_SPLIT_LEFT || SHIELD_MY_XIAO_SPLIT_RIGHT

config ZMK_SPLIT
    default y

endif # SHIELD_MY_XIAO_SPLIT_LEFT || SHIELD_MY_XIAO_SPLIT_RIGHT
```

## boards/shields/my_xiao_split/Kconfig.shield
```kconfig
config SHIELD_MY_XIAO_SPLIT_LEFT
    def_bool $(shields_list_contains,my_xiao_split_left)

config SHIELD_MY_XIAO_SPLIT_RIGHT
    def_bool $(shields_list_contains,my_xiao_split_right)
```
